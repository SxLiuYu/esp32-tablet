## sdkconfig.defaults
```kconfig
CONFIG_ESPTOOLPY_PORT="/dev/tty.usbserial-*"
CONFIG_ESPTOOLPY_BAUD_921600B=y
CONFIG_IDF_TARGET="esp32"
CONFIG_IDF_TARGET_ESP32=y
CONFIG_ESP32_REV_MIN_1=y
CONFIG_ESP32_DEFAULT_CPU_FREQ_160MHZ=y
CONFIG_SPIRAM=n
CONFIG_PARTITION_TABLE_CUSTOM=y
CONFIG_ESPTOOLPY_FLASHSIZE_4MB=y
CONFIG_PARTITION_TABLE_CUSTOM_FILENAME="partitions.csv"
CONFIG_LOG_DEFAULT_LEVEL_INFO=y
CONFIG_LVGL_TFT_DISPLAY_SWAP_XY=y
CONFIG_LVGL_TFT_DISPLAY_MIRROR_X=y
CONFIG_LVGL_TFT_DISPLAY_MIRROR_Y=y
CONFIG_LVGL_FB_IN_PSRAM=n
CONFIG_LVGL_COLOR_DEPTH_16=y
CONFIG_LVGL_TASK_STACK_SIZE=4096
CONFIG_LVGL_TICK_PERIOD_MS=5
CONFIG_ESP_WEBSOCKET_URI="ws://192.168.1.10:7103/ws/audio"
CONFIG_XIAOZHI_DEFAULT_WS_URL="ws://192.168.1.10:7104"
CONFIG_ESP_NETIF_STACK_SIZE=4096
CONFIG_ESP_SYSTEM_EVENT_QUEUE_SIZE=32
CONFIG_ESP_SYSTEM_EVENT_TASK_STACK_SIZE=4096
CONFIG_WIFI_TASK_STACK_SIZE=4096
CONFIG_ESP32_WIFI_DYNAMIC_TX_BUFFER=y
CONFIG_ESP32_WIFI_TX_BA_WIN=3
CONFIG_ESP32_WIFI_RX_BA_WIN=3
CONFIG_ESP32_WIFI_AMPDU_TX_ENABLED=n
CONFIG_ESP32_WIFI_AMPDU_RX_ENABLED=n
CONFIG_ESP_ERR_TO_NAME_LOOKUP=n
CONFIG_ESP_TASK_WDT=n
CONFIG_ESP_SYSTEM_CHECK=n
```
